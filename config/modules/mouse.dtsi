#define ZMK_MOUSE_DEFAULT_MOVE_VAL 1500
#define ZMK_MOUSE_DEFAULT_SCRL_VAL 20

#include <dt-bindings/zmk/mouse.h>
#include <behaviors/mouse_keys.dtsi>

&mmv {
  acceleration-exponent = <1>;
  time-to-max-speed-ms = <500>;
  delay-ms = <0>;
};

&msc {
  acceleration-exponent = <1>;
  time-to-max-speed-ms = <40>;
  delay-ms = <0>;
};

#define M_JUMP_LEFT  &kp LG(LC(LA(LEFT)))
#define M_JUMP_RIGHT &kp LG(LC(LA(RIGHT)))
#define M_JUMP_UP    &kp LG(LC(LA(UP)))
#define M_JUMP_DOWN  &kp LG(LC(LA(DOWN)))
